/*
  Sonic Drift External Sound
*/

#include <stdint.h>
#include "tm4c123gh6pm.h"
#include "Sound.h"
#include "Piano.h"
#include "TExaS.h"
#include "UART.h"
#include "FiFo.h"

void DisableInterrupts(void);
void EnableInterrupts(void); 
void DAC_Init_6bits(void); 
void DAC_Out_6bits(uint32_t data); 
void noteOn(uint32_t noteNumber); 
void EnableSongPlayback(void); 
void DisableSongPlayback(void); 
void Timer0A_Init(void(*task)(void), uint32_t period);
void Timer0A_Disable(void);
void NextBeat(void);
long StartCritical (void);    // previous I bit, disable interrupts
void EndCritical(long sr);    // restore I bit to previous value
void DAC_Test(void) ;
void noteOn_Single(uint32_t noteNumber);
void noteOff_Single(uint32_t noteNumber); 
void SwitchSong(uint8_t new_Song); 

// The SongBeat Structure: represents one beat in a song. 
// NoteNumber: the number of notes in this beat, from 0 to 4. 
// Notes[4]: the notes to played in the beat. 
struct SongBeat {
  uint8_t NoteNumber; 
  uint32_t Notes[4]; 
} typedef SongBeatType;

// Green Hill Zone
const SongBeatType GHZSong[785] = {
{1,{67}},
{0, {0}},
{1,{69}},
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{0, {0}}
}; 



// Scrap Brain Zone
const SongBeatType SBZSong[1194] = {
{1,{50}},
{0, {0}},
{1,{52}},
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{0, {0}}
};


// Options Music
const SongBeatType OptionsSong[599] = {
{1,{53}},
{0, {0}},
{0, {0}},
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{0, {0}}
}; 


// Results Music
const SongBeatType ResultsSong[33] = {
{1,{73}},
{1,{75}},
{0, {0}},
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{0, {0}}
};


// Title Music
const SongBeatType TitleSong[84] = {
{2,{79,82}},
{0, {0}},
{0, {0}},
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{0, {0}} 
};

uint32_t songPosition = 0; 

// This is a flag for which song is being played. 
#define TITLE_SONG 0
#define CHARSELECT_SONG 1
#define GHZ_SONG 2
#define SBZ_SONG 3
#define RESULT_SONG 4
uint8_t PianoMode = 5; 

int main(void){     
  char c1, c2, c3, c4, c5, c6, c7, c8; 
  // PLL, Texas stuff. 
  TExaS_Init(SW_PIN_PE3210,DAC_PIN_PB3210,ScopeOn);
  // Piano wrapper stuff.   
  Piano_Init();
  // DAC stuff. 
  DAC_Init_6bits();
  UART1_Init(); 
  
  // 80: 1 microsecond. This init allows updates every 5 microseconds. 
  Sound_Init(400);   // was 400
  // CSPIE.   
  EnableInterrupts();
  // Song playback stuff. 
  EnableSongPlayback(); 
  
  while(1){ 
    // Heartbeat
    Piano_In(); 
    // Handle FIFO stuff. 
    while (FiFo_Get(&c1) == 0 || c1 != 0x12) ; 
    while (FiFo_Get(&c2) == 0 || c2 != 0x34) ; 
    while (FiFo_Get(&c3) == 0) ; // Get the data
    while (FiFo_Get(&c4) == 0) ; // Get the data
    while (FiFo_Get(&c5) == 0) ; // Get the data
    while (FiFo_Get(&c6) == 0) ; // Get the data
    while (FiFo_Get(&c7) == 0 || c7 != 0x56) ; 
    while (FiFo_Get(&c8) == 0 || c8 != 0x78) ; 
    if (c3 == c4 && c4 == c5 && c5 == c6) {
      SwitchSong(c3); 
    }
  }  
}

void EnableSongPlayback(void) {
  Timer0A_Init(&NextBeat, 7000000); 
}

void DisableSongPlayback(void) {
  PianoMode = 0;  
  songPosition = 0;
}

void NextBeat(void) {
  uint8_t count; 
  
  switch (PianoMode) {
    case 0:
      if (songPosition >= 83) break;
      for (count = 0; count < TitleSong[songPosition].NoteNumber; count++) {
        noteOn(TitleSong[songPosition].Notes[count] - 18); 
      }
      songPosition++; 
      if (songPosition >= 84) songPosition = 0;
      break; 
    case 1:
      for (count = 0; count < OptionsSong[songPosition].NoteNumber; count++) {
        noteOn(OptionsSong[songPosition].Notes[count] - 18); 
      }
      songPosition++; 
      if (songPosition >= 599) songPosition = 0;
      break; 
    case 2:
      for (count = 0; count < GHZSong[songPosition].NoteNumber; count++) {
        noteOn(GHZSong[songPosition].Notes[count] - 18); 
      }
      songPosition++; 
      if (songPosition >= 785) songPosition = 0;
      break; 
    case 3:
      for (count = 0; count < SBZSong[songPosition].NoteNumber; count++) {
        noteOn(SBZSong[songPosition].Notes[count] - 18); 
      }
      songPosition++; 
      if (songPosition >= 1194) songPosition = 0;
      break; 
    case 4:
      if (songPosition >= 32) break;
      for (count = 0; count < ResultsSong[songPosition].NoteNumber; count++) {
        noteOn(ResultsSong[songPosition].Notes[count] - 18); 
      }
      songPosition++; 
      break;
    case 5:
      break; 
  }
} 

void SwitchSong(uint8_t new_Song) {
  if (new_Song == PianoMode) return; 
  PianoMode = new_Song;
  songPosition = 0; 
}

void DAC_Test(void) {
  uint32_t count = 0; 
  uint32_t DAC_O = 0; 
  while (1) {
    for (count = 0; count < 80000000; count++); 
    DAC_O ++; 
    if (DAC_O == 64) DAC_O = 0; 
    DAC_Out_6bits(DAC_O); 
  }
}
